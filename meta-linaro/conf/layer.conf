## meta-linaro/conf/layer.conf
```bitbake
BBPATH .= ":${LAYERDIR}"
BBFILES += "\
            ${LAYERDIR}/recipes-*/*/*.bb \
            ${LAYERDIR}/recipes-*/*/*.bbappend \
           "

BBFILE_COLLECTIONS += "linaro"
BBFILE_PATTERN_linaro := "^${LAYERDIR}/"
BBFILE_PRIORITY_linaro = "10"

# do not error out on bbappends for missing recipes
BB_DANGLINGAPPENDS_WARNONLY = "true"

LAYERDEPENDS_linaro = "linaro-toolchain"
```
